## components/widf_mngr/Kconfig
```kconfig
menu "WIDF Manager Configuration"

    config PORTAL_AP_SSID
        string "Portal AP SSID"
        default "WIDF-MANAGER"
        help
            SSID (network name) broadcasted by the captive portal AP.
            When AP security is enabled and this default value is used,
            the last 4 characters of the AP MAC address are automatically
            appended (e.g. WIDF-MANAGER-A348).

    config PORTAL_AP_PASSWORD
        string "Portal AP password"
        default ""
        help
            Password for the portal AP. Leave empty for an open AP.
            Minimum 8 characters required for WPA2/WPA3.
            If too short or empty with a secured auth mode, a MAC-derived
            fallback password is used and WIDF_EVENT_AP_PASSWORD_FALLBACK
            is fired.

    choice PORTAL_AP_AUTHMODE
        prompt "Portal AP authentication mode"
        default PORTAL_AP_AUTHMODE_WPA2_WPA3
        help
            Security mode for the portal AP.
            WPA2/WPA3 mixed mode is recommended for best compatibility.
            Requires a password of at least 8 characters.

        config PORTAL_AP_AUTHMODE_OPEN
            bool "Open (no password)"

        config PORTAL_AP_AUTHMODE_WPA2
            bool "WPA2-PSK"

        config PORTAL_AP_AUTHMODE_WPA3
            bool "WPA3-SAE"
            depends on ESP_WIFI_SOFTAP_SAE_SUPPORT

        config PORTAL_AP_AUTHMODE_WPA2_WPA3
            bool "WPA2/WPA3 mixed (recommended)"
            depends on ESP_WIFI_SOFTAP_SAE_SUPPORT

    endchoice

    config PORTAL_AP_AUTHMODE
        int
        default 0 if PORTAL_AP_AUTHMODE_OPEN
        default 3 if PORTAL_AP_AUTHMODE_WPA2
        default 6 if PORTAL_AP_AUTHMODE_WPA3
        default 7 if PORTAL_AP_AUTHMODE_WPA2_WPA3
        help
            Resolved integer value of wifi_auth_mode_t passed to the WiFi driver.
            0=OPEN, 3=WPA2_PSK, 6=WPA3_PSK, 7=WPA2_WPA3_PSK.

    config PORTAL_AUTH_PASSWORD
        string "Portal authentication password"
        default ""
        help
            Password required to access protected portal routes (/ota, /erase).
            Leave empty to disable authentication — protected routes are
            accessible without a password. Recommended for production devices.

    config PORTAL_AP_CHANNEL
        int "Portal AP Channel"
        range 1 13
        default 3
        help
            WiFi channel (network channel) for the portal AP.

    config PORTAL_MAX_STA_CONN
        int "Maximal STA connections"
        range 1 10
        default 5
        help
            Max number of devices that can connect to the portal AP.

    config PORTAL_TIMEOUT_S
        int "Portal timeout (seconds)"
        range 30 600
        default 180
        help
            How long the portal stays open before shutting down if no
            credentials are submitted. After timeout, a long press on the
            button reopens the portal.

    config PORTAL_MAX_RETRY
        int "STA connection retries"
        range 1 10
        default 3
        help
            Number of times to retry a STA connection per network before
            moving to the next saved network.

    config PORTAL_BUTTON_GPIO
        int "Portal reopen button GPIO pin"
        range 0 48
        default 3
        help
            GPIO pin for the active-low button used to reopen the portal
            after it has closed or timed out. Default is G3 on M5Stamp C3.
            Common alternatives: GPIO0 on most ESP32 DevKit boards,
            GPIO9 on ESP32-C6 and ESP32-H2 DevKit boards.

    config PORTAL_LONG_PRESS_MS
        int "Long press duration (milliseconds)"
        range 1000 10000
        default 3000
        help
            How long the button must be held continuously to trigger a
            portal reopen. 3000 ms (3 seconds) is the default.

    config PORTAL_DNS_ENABLED
        bool "Enable captive portal DNS server"
        default n
        help
            Starts a DNS server on port 53 that redirects all queries to
            192.168.4.1. Triggers automatic captive portal popups on some
            devices. Modern Android uses HTTPS for detection and will not
            show a popup regardless. Disable to save flash and RAM.

endmenu
```

## main/Kconfig.projbuild
```kconfig
menu "WIDF Manager Configuration"

    config PORTAL_AP_SSID
        string "Portal AP SSID"
        default "WIDF-MANAGER"
        help
            SSID (network name) broadcasted by the captive portal AP to connect to.

    config PORTAL_AP_CHANNEL
        int "Portal AP Channel"
        range 1 13
        default 3
        help
            WiFi channel (network channel) for the portal AP.

    config PORTAL_MAX_STA_CONN
        int "Maximal STA connections"
        range 1 10
        default 5
        help
            Max number of devices that can connect to the portal AP.

    config PORTAL_TIMEOUT_S
        int "Portal timeout (seconds)"
        range 30 600
        default 180
        help
            How long the portal stays open before shutting down if no
            credentials are submitted. After timeout, a long press on the
            button reopens the portal.

    config PORTAL_MAX_RETRY
        int "STA connection retries"
        range 1 10
        default 3
        help
            Number of times to retry a STA connection before giving up
            and opening the portal for new credentials.

    config PORTAL_BUTTON_GPIO
        int "Portal reopen button GPIO pin"
        range 0 48
        default 3
        help
            GPIO pin for the active-low button used to reopen the portal
            after it has closed or timed out. Default is G3 on M5Stamp C3.
            Common alternatives: GPIO0 on most ESP32 DevKit boards,
            GPIO9 on ESP32-C6 and ESP32-H2 DevKit boards.

    config PORTAL_LONG_PRESS_MS
        int "Long press duration (milliseconds)"
        range 1000 10000
        default 3000
        help
            How long the button must be held continuously to trigger a
            portal reopen. 3000 ms (3 seconds) is the default.

    config PORTAL_KEEP_AP_ACTIVE
        bool "Keep portal AP active after STA connects"
        default y
        help
            If enabled, the portal AP stays up after a successful STA
            connection so the portal remains accessible for reconfiguration
            at any time. Disable to switch to pure STA mode after connecting,
            reducing RF footprint and power consumption.
            The long press button will still reopen the portal.

    config PORTAL_REBOOT_ON_TIMEOUT
        bool "Reboot device when portal times out"
        default n
        help
            If enabled, the device reboots when the portal timeout is
            reached instead of waiting for a long press to reopen.
            Useful for headless or unattended deployments where no
            button is accessible. Pair with PORTAL_KEEP_AP_ACTIVE=n
            for a minimal-footprint headless configuration.
    
    
    config PORTAL_DNS_ENABLED
        bool "Enable captive portal DNS server"
        default n
        help
            Starts a DNS server on port 53 that redirects all queries to
            192.168.4.1. Triggers automatic captive portal popups on some
            devices. Modern Android uses HTTPS for detection and will not
            show a popup regardless. Disable to save flash and RAM.

endmenu
```
